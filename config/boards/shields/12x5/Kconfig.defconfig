## config/boards/shields/12x5/Kconfig.defconfig
```kconfig
# Copyright (c) 2020 The ZMK Contributors
# SPDX-License-Identifier: MIT
#
# https://zmkfirmware.dev/docs/development/new-shield#kconfigdefconfig
# The Kconfig.defconfig file is where overrides for various configuration 
# settings that make sense to have different defaults when this shield is used. 

if SHIELD_12X5

config ZMK_KEYBOARD_NAME
    default "12x5"
	bool "nice!nano"
	depends on SOC_NRF52840_QIAA
endif
```

## config/boards/shields/12x5/Kconfig.shield
```kconfig
# Copyright (c) 2020 The ZMK Contributors
# SPDX-License-Identifier: MIT
#
# https://zmkfirmware.dev/docs/development/new-shield#kconfigshield
# The Kconfig.shield file defines any additional Kconfig settings that 
# may be relevant when using this keyboard. For most keyboards, there
# is just one additional configuration value for the shield itself.

config SHIELD_12X5
    def_bool $(shields_list_contains,12X5)
```

## config/boards/shields/3X3/Kconfig.shield
```kconfig
# Copyright (c) 2020 The ZMK Contributors
# SPDX-License-Identifier: MIT
#
# https://zmkfirmware.dev/docs/development/new-shield#kconfigshield
# The Kconfig.shield file defines any additional Kconfig settings that 
# may be relevant when using this keyboard. For most keyboards, there
# is just one additional configuration value for the shield itself.

config SHIELD_3X3
    def_bool $(shields_list_contains,3X3)
```
